## package/intel-mediadriver/Config.in
```kconfig
config BR2_PACKAGE_INTEL_MEDIADRIVER
	bool "intel-mediadriver"
	depends on BR2_x86_64
	depends on BR2_PACKAGE_LIBVA_INTEL_QSV
	depends on BR2_PACKAGE_XLIB_LIBX11
	select BR2_PACKAGE_INTEL_GMMLIB
	select BR2_PACKAGE_LIBPCIACCESS
	help
	  The Intel(R) Media Driver for VAAPI is a new VA-API (Video
	  Acceleration API) user mode driver supporting hardware
	  accelerated decoding, encoding, and video post processing for
	  GEN based graphics hardware.

comment "intel-mediadriver needs libva w/ Intel(R) QuickSync support"
	  depends on !BR2_PACKAGE_LIBVA_INTEL_QSV

comment "intel-mediadriver needs libx11"
	  depends on !BR2_PACKAGE_XLIB_LIBX11
```

## package/intel-mediasdk/Config.in
```kconfig
config BR2_PACKAGE_INTEL_MEDIASDK
	bool "intel-mediasdk"
	depends on BR2_x86_64
    depends on BR2_PACKAGE_INTEL_MEDIADRIVER
    select BR2_PACKAGE_LIBDRM
    select BR2_PACKAGE_LIBDRM_INTEL
    help
        Intel(R) Media SDK provides an API to access hardware-accelerated video 
        decode, encode and filtering on Intel® platforms with integrated 
        graphics.

        Supported video encoders: HEVC, AVC, MPEG-2, JPEG
        Supported Video decoders: HEVC, AVC, VP8, MPEG-2, VC1, JPEG
        Supported video pre-processing filters: Color Conversion, Deinterlace, 
        Denoise, Resize, Rotate, Composition
```

## package/libva/Config.in
```kconfig
config BR2_PACKAGE_LIBVA
	bool "libva"
	depends on BR2_TOOLCHAIN_HAS_THREADS # libdrm/libpthread-stubs
	depends on !BR2_STATIC_LIBS
	select BR2_PACKAGE_LIBDRM
	select BR2_PACKAGE_XLIB_LIBX11 if BR2_PACKAGE_XORG7
	select BR2_PACKAGE_XLIB_LIBXEXT if BR2_PACKAGE_XORG7
	select BR2_PACKAGE_XLIB_LIBXFIXES if BR2_PACKAGE_XORG7
	help
	  The main motivation for VA-API (Video Acceleration API) is to
	  enable hardware accelerated video decode/encode at various
	  entry-points (VLD, IDCT, Motion Compensation etc.) for the
	  prevailing coding standards today (MPEG-2, MPEG-4 ASP/H.263,
	  MPEG-4 AVC/H.264, and VC-1/VMW3).

	  https://01.org/linuxmedia/vaapi

if BR2_PACKAGE_LIBVA

config BR2_PACKAGE_LIBVA_INTEL_QSV
	bool "Intel(R) QuickSync Video support version"
	depends on BR2_x86_64
	depends on BR2_TOOLCHAIN_USES_GLIBC
	depends on BR2_TOOLCHAIN_HEADERS_AT_LEAST_4_14
	help
	  Use Intels custom version of libva that enables Intel
	  QuickSync video encoding/decoding feature on Intel(R)
	  processors.

comment "Intel(R) QuickSync Video support needs a glibc toolchain and GNU/Linux Kernel >= 4.14 at least"
	depends on !BR2_TOOLCHAIN_HEADERS_AT_LEAST_4_14 || !BR2_TOOLCHAIN_USES_GLIBC
endif

comment "libva needs a toolchain w/ threads, dynamic library"
	depends on !BR2_TOOLCHAIN_HAS_THREADS || BR2_STATIC_LIBS
```
